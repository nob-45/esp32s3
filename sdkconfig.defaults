## sdkconfig.defaults
```kconfig
# SmartElderCare 项目默认配置（ESP32-S3-DevKitC-1 N16R8）

# 目标芯片
CONFIG_IDF_TARGET="esp32s3"

# Flash 大小 8MB (实测板子为 8MB Flash)
CONFIG_ESPTOOLPY_FLASHSIZE_8MB=y
CONFIG_ESPTOOLPY_FLASHSIZE="8MB"

# 启用 PSRAM (Octal 8MB)
CONFIG_SPIRAM=y
CONFIG_SPIRAM_MODE_OCT=y
CONFIG_SPIRAM_SPEED_80M=y

# CPU 频率
CONFIG_ESP_DEFAULT_CPU_FREQ_MHZ_240=y
CONFIG_ESP_DEFAULT_CPU_FREQ_MHZ=240

# 日志级别
CONFIG_LOG_DEFAULT_LEVEL_INFO=y

# FreeRTOS Tick 1000Hz
CONFIG_FREERTOS_HZ=1000

# 分区表 (使用自定义)
CONFIG_PARTITION_TABLE_CUSTOM=y
CONFIG_PARTITION_TABLE_CUSTOM_FILENAME="partitions.csv"
CONFIG_PARTITION_TABLE_FILENAME="partitions.csv"

# 串口波特率
CONFIG_ESPTOOLPY_MONITOR_BAUD=115200

# ============================================================
# 摄像头 esp32-camera 需要的配置
# ============================================================
# 允许 malloc 从 PSRAM 分配（帧缓冲要放 PSRAM）
CONFIG_SPIRAM_USE_MALLOC=y
CONFIG_SPIRAM_MALLOC_ALWAYSINTERNAL=16384
CONFIG_SPIRAM_TRY_ALLOCATE_WIFI_LWIP=y

# LWIP / HTTP 服务器（图传要用）
CONFIG_LWIP_MAX_SOCKETS=10
CONFIG_HTTPD_MAX_REQ_HDR_LEN=1024
CONFIG_HTTPD_MAX_URI_LEN=512
```
